## Kconfig
```kconfig
config SPECTRA_ISP
	bool "enable camera ISP modele"
	help
	  This is enabling camera ISP module.
	  IFE camera driver file be included.
	  This will enable camera ISP driver to handle IFE driver.
	  Core camera driver to handle VFE HW.

config SPECTRA_ICP
	bool "enable camera ICP modele"
	help
	  This is enabling camera ICP module.
	  Camera ICP driver file be included.
	  This will enable camera ICP driver to interact with,
	  ICP FW. Which can control IPE and BPS HW.

config SPECTRA_JPEG
	bool "enable camera jpeg modele"
	help
	  This is enabling camera JPEG module.
	  camera jpeg module will be functional.
	  This module interact with jpeg HW for,
	  snapshot processing.

config SPECTRA_CUSTOM
	bool "enable camera custom modele"
	help
	  This is enabling camera custom module.
	  camera cusotm hw feature.
	  Basicaly oem can use this flag to modify or,
	  customized kernel driver.

config SPECTRA_TFE
	bool "enable camera tfe modele"
	help
	  This is enabling camera tfe module.
	  tfe module files will be included to enable tfe based driver,
	  files.

config SPECTRA_USE_CLK_CRM_API
	bool "enable camera cesta clk feature"
	help
	  This is enabling camera cesta feature.
	  kernel clk driver api will cache the clk value,
	  send by camera hw and apply to CRM hw.
	  CRM hw will consolidate and apply the clk to camera HW.

config SPECTRA_USE_RPMH_DRV_API
	bool "enable camera new ICC BW api"
	help
	  This is helping to set BW through kernel icc driver.
	  Kernel icc driver do caching the bw information.
	  icc driver will update the bw information RPMH,
	  to apply proper bw voting for camera to mmnoc.

config SPECTRA_LLCC_STALING
	bool "enable camera new LLCC staling feature"
	help
	  This will enable to call LLCC driver cache notification API,
	  and increment count API.
	  Which will enable LLCC staling feature,based on counter,
	  invalidate the cache slice.
```

## blair_consolidate_defconfig
```kconfig
CONFIG_SPECTRA_ISP = y
CONFIG_SPECTRA_ICP = y
CONFIG_SPECTRA_JPEG = y
CONFIG_SPECTRA_CUSTOM = y
CONFIG_SPECTRA_TFE = y
```
